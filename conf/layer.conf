## conf/layer.conf
```bitbake
# We have a conf and classes directory, append to BBPATH
BBPATH .= ":${LAYERDIR}"

# We have a recipes directory, add to BBFILES
BBFILES += "${LAYERDIR}/recipes*/*/*.bb \
            ${LAYERDIR}/recipes*/*/*.bbappend"

BBFILE_COLLECTIONS += "meta-comxpress"
BBFILE_PATTERN_meta-comxpress := "^${LAYERDIR}/"
BBFILE_PRIORITY_meta-comxpress = "6"
LAYERSERIES_COMPAT_meta-comxpress = "thud"
LAYERDEPENDS_meta-comxpress = "meta-altera"
```

## conf/machine/comxpress.conf
```bitbake
#@TYPE: Machine
#@NAME: COMXpress
#@DESCRIPTION: Machine configuration for the REFLEX CES COMXpressSX Stratix 10 Board"

require conf/machine/include/arm/arch-armv8.inc

SPL_BINARY = "spl/u-boot-spl-dtb.bin"
UBOOT_SUFFIX = "img"
UBOOT_BINARY = "u-boot-dtb.img"
UBOOT_IMAGE = "u-boot-dtb-${MACHINE}-${PV}-${PR}.${UBOOT_SUFFIX}"
PREFERRED_PROVIDER_virtual/bootloader ?= "u-boot-socfpga"
PREFERRED_VERSION_u-boot-socfpga ?= "v2017.09%"

UBOOT_CONFIG ??= "comxpress"                                              
#UBOOT_CONFIG[comxpress] = "socfpga_comxpress_defconfig"

PREFERRED_PROVIDER_virtual/kernel ?= "linux-altera"
PREFERRED_VERSION_linux-altera ?= "5.0%"
KERNEL_IMAGETYPE = "Image"

KERNEL_DEVICETREE_comxpress ?= "altera/socfpga_stratix10_comxpress.dtb"
EXTRA_IMAGE_FEATURES += "autoserial"
FEATURE_PACKAGES_autoserial = "auto-serial-console"

IMAGE_FSTYPES ?= "cpio ext3 tar.gz"
MACHINE_ESSENTIAL_EXTRA_RRECOMMENDS="kernel-modules"

DISTRO_FEATURES_remove = "wayland"                                              
DISTRO_FEATURES_remove = "alsa"
```
